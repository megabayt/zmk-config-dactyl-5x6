## boards/shields/dactyl_5x6/Kconfig.defconfig
```kconfig
if SHIELD_dactyl_5x6_left

config ZMK_KEYBOARD_NAME
    default "dactyl_5x6"
endif

if SHIELD_dactyl_5x6_left || SHIELD_dactyl_5x6_right

config ZMK_SPLIT
    default y
endif
```

## boards/shields/dactyl_5x6/Kconfig.shield
```kconfig
config SHIELD_dactyl_5x6_left
    def_bool $(shields_list_contains, dactyl_5x6_left)
config SHIELD_dactyl_5x6_right
    def_bool $(shields_list_contains, dactyl_5x6_right)
```

## config/boards/shields/dactyl_5x6/Kconfig.defconfig
```kconfig
if SHIELD_dactyl_5x6_left

config ZMK_KEYBOARD_NAME
    default "dactyl_5x6"

config ZMK_SPLIT_ROLE_CENTRAL
    default y

endif

if SHIELD_dactyl_5x6_left || SHIELD_dactyl_5x6_right

    config ZMK_SPLIT
        default y

endif
```
